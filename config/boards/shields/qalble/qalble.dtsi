/ {
    left_encoder: encoder_left {
            compatible = "alps,ec11";
            label = "LEFT_ENCODER";
            a-gpios = <&gpio0 28 (GPIO_ACTIVE_HIGH | GPIO_PULL_UP)>;
            b-gpios = <&gpio0 30 (GPIO_ACTIVE_HIGH | GPIO_PULL_UP)>;
            resolution = <4>;
        };

    sensors {
        compatible = "zmk,keymap-sensors";
        sensors = <&left_encoder>;
    };
};