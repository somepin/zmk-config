/ {
    left_encoder: encoder_left {
            compatible = "alps,ec11";
            label = "LEFT_ENCODER";
            a-gpios = <&pro_micro 0 (GPIO_ACTIVE_HIGH | GPIO_PULL_UP)>;
            b-gpios = <&pro_micro 1 (GPIO_ACTIVE_HIGH | GPIO_PULL_UP)>;
            steps = <80>;
        };

    sensors {
        compatible = "zmk,keymap-sensors";
        sensors = <&left_encoder>;
        triggers-per-rotation = <24>;
    };
};
