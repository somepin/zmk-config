## config/boards/arm/itsybitsy_nrf52840/Kconfig.board
```kconfig
# Adafruit ItsyBitsy nRF52840 express board configuration
#
# Copyright (c) 2020 The ZMK Contributors
# SPDX-License-Identifier: MIT
#

config BOARD_ITSYBITSY_NRF52840
	bool "itsybitsy_nrf52840"
	depends on SOC_NRF52840_QIAA
```

## config/boards/shields/elchibre/Kconfig.defconfig
```kconfig
if SHIELD_ELCHIBRE
    config ZMK_KEYBOARD_NAME
        default "El Chibre"
endif
```
