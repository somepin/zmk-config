## config/boards/arm/nk_classic_tkl/Kconfig.board
```kconfig
# NK_CLASSIC_TKL board configuration

# Copyright (c) 2025 The ZMK Contributors
# SPDX-License-Identifier: MIT

config BOARD_NK_CLASSIC_TKL
    bool "NK_ Classic TKL"
    depends on SOC_STM32F072XB
```

## config/boards/arm/nk_classic_tkl/Kconfig.defconfig
```kconfig
# NK_ Classic TKL board configuration

# Copyright (c) 2025 The ZMK Contributors
# SPDX-License-Identifier: MIT

if BOARD_NK_CLASSIC_TKL

config BOARD
    default "nk_classic_tkl"

config ZMK_KEYBOARD_NAME
    default "NK_ Classic TKL"

config ZMK_USB
    default y

config ZMK_KSCAN_MATRIX_POLLING
    default y

endif # BOARD_NK_CLASSIC_TKL
```

## config/boards/arm/nk_classic_tkl/nk_classic_tkl_defconfig
```kconfig
# SPDX-License-Identifier: MIT

CONFIG_SOC_SERIES_STM32F0X=y
CONFIG_SOC_STM32F072XB=y
# 48MHz system clock
CONFIG_SYS_CLOCK_HW_CYCLES_PER_SEC=48000000

# enable PINMUX
CONFIG_PINCTRL=y

# enable GPIO
CONFIG_GPIO=y

# ZMK Settings
CONFIG_ZMK_USB=y
# CONFIG_ZMK_KSCAN_MATRIX_POLLING=y
CONFIG_USB_SELF_POWERED=n

# Needed to reduce this to size that will fit on F072 more easily
CONFIG_ISR_STACK_SIZE=756

# clock configuration
CONFIG_CLOCK_CONTROL=y

# Enable flash for settings storage
CONFIG_FLASH=y
CONFIG_FLASH_MAP=y
CONFIG_NVS=y

# RAM Reduction

CONFIG_ZMK_STUDIO_RPC_THREAD_STACK_SIZE=2048
CONFIG_ZMK_BEHAVIOR_LOCAL_ID_TYPE_CRC16=y

CONFIG_USB_WORKQUEUE_STACK_SIZE=512
CONFIG_USB_CDC_ACM_RINGBUF_SIZE=256
CONFIG_SYSTEM_WORKQUEUE_STACK_SIZE=2048
CONFIG_IDLE_STACK_SIZE=128

CONFIG_ZMK_KEYMAP_LAYER_NAME_MAX_LEN=10

CONFIG_ZMK_BEHAVIORS_QUEUE_SIZE=16
CONFIG_ZMK_BEHAVIOR_HOLD_TAP_MAX_HELD=4
CONFIG_ZMK_BEHAVIOR_HOLD_TAP_MAX_CAPTURED_EVENTS=15
CONFIG_ZMK_COMBO_MAX_COMBOS_PER_KEY=3
CONFIG_ZMK_COMBO_MAX_KEYS_PER_COMBO=3
```
